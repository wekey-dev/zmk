## app/boards/arm/wekey/Kconfig
```kconfig
# Copyright (c) 2020 The ZMK Contributors
# SPDX-License-Identifier: MIT

config BOARD_ENABLE_DCDC
	bool "Enable DCDC mode"
	select SOC_DCDC_NRF52X
	default y
	depends on (BOARD_WE60_2_0 || BOARD_WE65_2_0 || BOARD_WE65_2_3 || BOARD_WE65I_2_2 || BOARD_WE65I_3_0)

config BOARD_CHARGER_CTRL
	bool "Enable battery charger"
	default y
	depends on (BOARD_WE60_2_0 || BOARD_WE65_2_0 || BOARD_WE65_2_3 || BOARD_WE65I_2_2 || BOARD_WE65I_3_0)
```

## app/boards/arm/wekey/Kconfig.board
```kconfig
# Wekey board configuration

# Copyright (c) 2020 The ZMK Contributors
# SPDX-License-Identifier: MIT

config BOARD_WE65I_2_2
	bool "we65i_2_2"
	depends on SOC_NRF52840_QIAA

config BOARD_WE65I_3_0
	bool "we65i_3_0"
	depends on SOC_NRF52840_QIAA

config BOARD_WE65_2_0
	bool "we65_2_0"
	depends on SOC_NRF52840_QIAA

config BOARD_WE65_2_3
	bool "we65_2_3"
	depends on SOC_NRF52840_QIAA

config BOARD_WE60_2_0
	bool "we60_2_0"
	depends on SOC_NRF52840_QIAA
```

## app/boards/arm/wekey/Kconfig.defconfig
```kconfig
# Electronut Labs Papyr board configuration

# Copyright (c) 2020 The ZMK Contributors
# SPDX-License-Identifier: MIT

if USB

config USB_NRFX
	default y

config USB_DEVICE_STACK
	default y

endif # USB

config BT_CTLR
	default BT

config ZMK_BLE
	default y

config ZMK_USB
	default y

config PINMUX
	default y

config BOARD_CHARGER_CTRL
	default y

config ZMK_BATTERY_VOLTAGE_DIVIDER
	default y


# Config for BOARD

if BOARD_WE65I_3_0
config BOARD
	default "we65i_3_0"
config ZMK_KEYBOARD_NAME
	default "WE65I"
endif

if BOARD_WE65I_2_2
config BOARD
	default "we65i_2_2"
config ZMK_KEYBOARD_NAME
	default "WE65I"
endif

if BOARD_WE65_2_0
config BOARD
	default "we65_2_0"
config ZMK_KEYBOARD_NAME
	default "WE65"
endif

if BOARD_WE65_2_3
config BOARD
	default "we65_2_3"
config ZMK_KEYBOARD_NAME
	default "WE65"
endif

if BOARD_WE60_2_0
config BOARD
	default "we60_2_0"
config ZMK_KEYBOARD_NAME
	default "WE60"
endif
```

## app/boards/arm/wekey/we65i_2_2_defconfig
```kconfig
# Copyright (c) 2020 The ZMK Contributors
# SPDX-License-Identifier: MIT

CONFIG_SOC_SERIES_NRF52X=y
CONFIG_SOC_NRF52840_QIAA=y
CONFIG_BOARD_WE65I_2_2=y

CONFIG_BT_MAX_CONN=3
CONFIG_BT_MAX_PAIRED=1
CONFIG_ZMK_SLEEP=y

# Enable MPU
CONFIG_ARM_MPU=y

# enable GPIO
CONFIG_GPIO=y

CONFIG_USE_DT_CODE_PARTITION=y

CONFIG_MPU_ALLOW_FLASH_WRITE=y
CONFIG_NVS=y
CONFIG_SETTINGS_NVS=y
CONFIG_FLASH=y
CONFIG_FLASH_PAGE_LAYOUT=y
CONFIG_FLASH_MAP=y
CONFIG_CLOCK_CONTROL_NRF=y
CONFIG_CLOCK_CONTROL_NRF_K32SRC_RC=y

CONFIG_ZMK_RGB_UNDERGLOW=y
# Use the STRIP config specific to the LEDs you're using
CONFIG_WS2812_STRIP=y
CONFIG_ZMK_RGB_UNDERGLOW_EXT_POWER=y
CONFIG_ZMK_RGB_UNDERGLOW_ON_START=n

# Uncomment to enable encoder
CONFIG_EC11=y
CONFIG_EC11_TRIGGER_GLOBAL_THREAD=y
```
