## app/boards/wekey/we6k_v15/Kconfig.defconfig
```kconfig
# Copyright (c) 2021 The ZMK Contributors
# SPDX-License-Identifier: MIT

if BOARD_WE6K_V15

config ZMK_KEYBOARD_NAME
    default "WE6K_V15"

if USB

config USB_NRFX
    default y

config USB_DEVICE_STACK
    default y

endif # USB

config BT_CTLR
    default BT

endif # BOARD_WE6K_V15
```

## app/boards/wekey/we6k_v15/board.yml
```yaml
board:
  name: we6k_v15
  vendor: wekey
  socs:
    - name: nrf52840
      variants:
        - name: zmk
```
